## Project/GD32F2_STD/board/Kconfig
```kconfig
menu "Hardware Drivers Config"

config SOC_GD32F2X
    bool
    select SOC_SERIES_GD32F2
    default y

menu "Onboard Peripheral Drivers"

    config BSP_USING_SPI_FLASH
        bool "Enable SPI FLASH (W25Q16 spi1)"
	select BSP_USING_SPI
        select BSP_USING_SPI1
        select RT_USING_SFUD
        select RT_SFUD_USING_SFDP
        default n

endmenu

menu "On-chip Peripheral Drivers"

    config BSP_USING_UART_485
        bool

    config BSP_USING_GPIO
        bool "Enable GPIO"
        select RT_USING_PIN
        default y

    menuconfig BSP_USING_UART
        bool "Enable UART"
        default y
        if BSP_USING_UART
            config BSP_USING_UART0
                bool "Enable UART0"
                default y
            
            config BSP_UART0_485
                bool "Enable UART0 485 MODE"
                depends on BSP_USING_UART0
                select BSP_USING_UART_485
                default n

            config BSP_USING_UART1
                bool "Enable UART1"
                default n

            config BSP_UART1_485
                bool "Enable UART1 485 MODE"
                depends on BSP_USING_UART1
                select BSP_USING_UART_485
                default n
                
            config BSP_USING_UART2
                bool "Enable UART2"
                default n

            config BSP_UART2_485
                bool "Enable UART2 485 MODE"
                depends on BSP_USING_UART2
                select BSP_USING_UART_485
                default n
        endif    


	
    menuconfig BSP_USING_SPI
        bool "Enable SPI BUS"
        default n
        select RT_USING_SPI
        if BSP_USING_SPI
            config BSP_USING_SPI0
                bool "Enable SPI0 BUS"
                default n

            config BSP_SPI0_TX_USING_DMA
                bool 
                depends on BSP_USING_SPI0
                default n
                        
            config BSP_SPI0_RX_USING_DMA
                bool 
                depends on BSP_USING_SPI0
                select BSP_SPI0_TX_USING_DMA
                default n

            config BSP_USING_SPI1
                bool "Enable SPI1 BUS"
                default n

            config BSP_SPI1_TX_USING_DMA
                bool 
                depends on BSP_USING_SPI1
                default n
                        
            config BSP_SPI1_RX_USING_DMA
                bool 
                depends on BSP_USING_SPI1
                select BSP_SPI1_TX_USING_DMA
                default n

            config BSP_USING_SPI2
                bool "Enable SPI2 BUS"
                default n

            config BSP_SPI2_TX_USING_DMA
                bool 
                depends on BSP_USING_SPI2
                default n
                        
            config BSP_SPI2_RX_USING_DMA
                bool 
                depends on BSP_USING_SPI2
                select BSP_SPI2_TX_USING_DMA
                default n
        endif


    config BSP_USING_ON_CHIP_FLASH
        bool "Enable on-chip FLASH"
        default n 
    
    if BSP_USING_ON_CHIP_FLASH
        config ON_CHIP_FLASH_MAX_ERASE_SIZE
            int "ON_CHIP_FLASH_MAX_ERASE_SIZE"
            default 2048
    endif

endmenu

menu "Board extended module Drivers"

endmenu

endmenu
```
